## boards/shields/splitkb_aurora_helix/Kconfig.defconfig
```kconfig
#
# To keep this file less mess, the board specific settings are defined using cmake-args.
#

# Max 16 characters in keyboard name
config ZMK_KEYBOARD_NAME
    default "Aurora Helix"

config ZMK_SPLIT
    default y

# Set this to ZMK_SPLIT_BLE_CENTRAL_PERIPHERALS + your desired number of BT profiles (default is 5)
config BT_MAX_CONN
    default 6

# Set this to the same number as BT_MAX_CONN
config BT_MAX_PAIRED
    default 6

config ZMK_RGB_UNDERGLOW
    select WS2812_STRIP
    select SPI

if ZMK_DISPLAY

config SSD1306
    default y

config I2C
    default y

endif # ZMK_DISPLAY


if LVGL

config LV_Z_VDB_SIZE
    default 64

config LV_DPI_DEF
    default 148

config LV_Z_BITS_PER_PIXEL
    default 1

choice LV_COLOR_DEPTH
    default LV_COLOR_DEPTH_1
endchoice

endif # LVGL
```

## boards/shields/splitkb_aurora_helix/Kconfig.shield
```kconfig
# No whitespace after the comma or in the keyboard name!
config SHIELD_AURORA_HELIX_DONGLE
    def_bool $(shields_list_contains,splitkb_aurora_helix_dongle)

config SHIELD_AURORA_HELIX_LEFT
    def_bool $(shields_list_contains,splitkb_aurora_helix_left)

config SHIELD_AURORA_HELIX_RIGHT
    def_bool $(shields_list_contains,splitkb_aurora_helix_right)
```
