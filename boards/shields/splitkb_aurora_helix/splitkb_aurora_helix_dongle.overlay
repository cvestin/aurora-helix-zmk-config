/*
 * Copyright (c) 2023 The ZMK Contributors
 *
 * SPDX-License-Identifier: MIT
 */

#include "splitkb_aurora_helix.dtsi"
#include "splitkb_aurora_helix_physical_layout.dtsi"

/ {
    chosen {
        zmk,kscan = &mock_kscan;
        zmk,physical_layout = &physical_layout;
    };
 
    mock_kscan: mock_kscan_0 {
        compatible = "zmk,kscan-mock";
        columns = <0>;
        rows = <0>;
        events = <0>;
    };
};

&physical_layout {
    transform = <&default_transform>;
};